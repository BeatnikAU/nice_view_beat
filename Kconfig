## Kconfig
```kconfig
config NICE_VIEW_WIDGET_STATUS
    bool "Enable nice!view custom status widgets"
    default y
    depends on ZMK_DISPLAY
    help
      Enable the custom status widgets (like the bouldering wall) 
      for the nice!view display.
```
